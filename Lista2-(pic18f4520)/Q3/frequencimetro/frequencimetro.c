#include <p18f4520.h>

#define sinal PORTAbits.RA6 

unsigned char converte_BCD [100] = {
	0x00,0x01,0x02,0x03,0x04,0x05,0x06,0x07,0x08,0x09,
	0x10,0x11,0x12,0x13,0x14,0x15,0x16,0x17,0x18,0x19,
	0x20,0x21,0x22,0x23,0x24,0x25,0x26,0x27,0x28,0x29,
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	0x90,0x91,0x92,0x93,0x94,0x95,0x96,0x97,0x98,0x99,
};

char delay(void){

	unsigned int i;
	for(i=0;i<4;i++){}
}


int mede_periodo(void){

	int contador=0;
	while(sinal){} //espera descer
	while(!sinal){} //espera subir
	while(sinal){
		
		delay();
		contador++;
	}
	while(!sinal){
		
		delay();
		contador++;
	}
	return contador;
}

int calcula_freq(int contador){
    double a = 1;
    double b = (double)contador;
    double calc = ((a / b)* 10000);
    int calculo = (int)calc;
	return calculo;
}

char mostrar(char freq){
	if(freq > 99){
		PORTC = 0xEE;
	}else if(freq <= 10){
		PORTC = converte_BCD[10];
	}else{
		PORTC = converte_BCD[freq];
	}
}
main(){

	ADCON1 = 0x0F; // Desliga portas analógicas
	TRISC = 0b00000000;  // Display 7 segmentos como saída nas portas C
	TRISAbits.RA6 = 1; 
	delay();
	while(1){
		mostrar(calcula_freq(mede_periodo()));
	}
}